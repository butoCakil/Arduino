#include <U8g2lib.h>

#ifdef U8X8_HAVE_HW_SPI
#include <SPI.h>
#endif
#ifdef U8X8_HAVE_HW_I2C
#include <Wire.h>
#endif

#define START_BTN 0
#define STOP_BTN 2

int posisiXnya = 0;
int jarakGerak = 10;

U8G2_SSD1306_128X64_NONAME_F_SW_I2C u8g2(U8G2_R0, SCL, SDA, U8X8_PIN_NONE);

// 'emo_smile', 48x48px
const unsigned char epd_bitmap_emo_smile[] = {
  0x00, 0x00, 0x00, 0x00, 0x00, 0x00, 0x00, 0x00, 0x00, 0x00, 0x00, 0x00, 0x00, 0x00, 0x00, 0x00,
  0x00, 0x00, 0x00, 0x00, 0xf0, 0x0f, 0x00, 0x00, 0x00, 0x00, 0xfe, 0x7f, 0x00, 0x00, 0x00, 0xc0,
  0x0f, 0xf0, 0x03, 0x00, 0x00, 0xe0, 0x01, 0x80, 0x07, 0x00, 0x00, 0x78, 0x00, 0x00, 0x1e, 0x00,
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  0x00, 0x00, 0x00, 0x00, 0x00, 0x00, 0x00, 0x00, 0x00, 0x00, 0x00, 0x00, 0x00, 0x00, 0x00, 0x00
};

const int epd_bitmap_allArray_LEN = 1;

// [1] diganti sesuai jumlah file gambar
const unsigned char* epd_bitmap_allArray[1] = {
  epd_bitmap_emo_smile
};

int posisi1[] = {
  10, 20, 50, 40, 20, 0, 30
};

void setup() {
  Serial.begin(115200);

  pinMode(START_BTN, INPUT_PULLUP);
  pinMode(STOP_BTN, INPUT_PULLUP);

  SPI.begin();
  u8g2.begin();

  tampilanText("Simple Animasi", "Mulai Test ESP32");

  delay(2000);
}

void loop() {
  animasi(1);

  // delay untuk mempertahankan tampilan selama 2 detik
  delay(2000);
}

void tampilanText(String konten, String judul) {
  u8g2.clearBuffer();
  u8g2.setFont(u8g2_font_luBS08_tf);
  u8g2.drawStr(0, 10, judul.c_str());
  u8g2.drawStr(32, 48, konten.c_str());
  u8g2.sendBuffer();
}

void posisi(int _nomorIcon, int _posisiX, int _posisiY) {
  u8g2.clearBuffer();
  u8g2.drawXBM(_posisiX, _posisiY, 48, 48, epd_bitmap_allArray[_nomorIcon]);
  u8g2.sendBuffer();
}

void animasi(int nomorAnimasi) {
  if (nomorAnimasi == 1) {
    // Menghitung jumlah elemen dalam array
    int jumlahElement = sizeof(posisi1) / sizeof(posisi1[0]);

    // menjalankan pergerakan posisi sesuai data posisi pada array `posisi1`
    for (int i = 0; i < jumlahElement; i++) {
      // mengambil nilai posisi di array `posisi1` sesuai urutan
      posisiXnya = posisi1[i];

      // menampilkan gambarnya sesuai posisi yang diubah2
      posisi(0, posisiXnya, 16);

      // delay agar gerak tidak terlalu cepat
      delay(100);
    }
  } else if (nomorAnimasi == 2){
    // Lanjutkan untuk Icon / posisi yang lain
  } else {
    // Jika tidak ada animasi
  }
}