#include <U8g2lib.h>

#ifdef U8X8_HAVE_HW_SPI
#include <SPI.h>
#endif
#ifdef U8X8_HAVE_HW_I2C
#include <Wire.h>
#endif

#define START_BTN 0
#define STOP_BTN 2

U8G2_SSD1306_128X64_NONAME_F_HW_I2C u8g2(U8G2_R0, SCL, SDA, U8X8_PIN_NONE);
// SW_I2C untuk SLOW Frame Rate
// HW_I2C untuk HIGH Frame Rate

// 'emo_smile', 48x48px
const unsigned char epd_bitmap_emo_smile[] = {
  0x00, 0x00, 0x00, 0x00, 0x00, 0x00, 0x00, 0x00, 0x00, 0x00, 0x00, 0x00, 0x00, 0x00, 0x00, 0x00,
  0x00, 0x00, 0x00, 0x00, 0xf0, 0x0f, 0x00, 0x00, 0x00, 0x00, 0xfe, 0x7f, 0x00, 0x00, 0x00, 0xc0,
  0x0f, 0xf0, 0x03, 0x00, 0x00, 0xe0, 0x01, 0x80, 0x07, 0x00, 0x00, 0x78, 0x00, 0x00, 0x1e, 0x00,
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  0x00, 0x00, 0x00, 0x00, 0x00, 0x00, 0x00, 0x00, 0x00, 0x00, 0x00, 0x00, 0x00, 0x00, 0x00, 0x00
};

// 'emo-smile-brush', 48x48px
const unsigned char epd_bitmap_emo_smile_brush[] = {
  0x00, 0x00, 0x00, 0x00, 0x00, 0x00, 0x00, 0x00, 0x00, 0x00, 0x00, 0x00, 0x00, 0x00, 0x00, 0x00,
  0x00, 0x00, 0x00, 0x10, 0x00, 0x00, 0x00, 0x00, 0x00, 0x20, 0x00, 0x40, 0x00, 0x00, 0x00, 0xc0,
  0x01, 0x00, 0x30, 0x00, 0x00, 0x80, 0xff, 0xbf, 0x11, 0x00, 0x00, 0x00, 0x1f, 0xf8, 0x03, 0x00,
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  0x00, 0x00, 0x00, 0x00, 0x00, 0x00, 0x00, 0x00, 0x00, 0x00, 0x00, 0x00, 0x00, 0x00, 0x00, 0x00
};

// '8iEb4KGBT (2)', 48x48px
const unsigned char epd_bitmap_spiderman[] = {
  0x00, 0x00, 0x00, 0x00, 0x00, 0x00, 0x00, 0x00, 0x00, 0x00, 0x00, 0x00, 0x00, 0x00, 0x00, 0x00,
  0x00, 0x00, 0x00, 0x00, 0x00, 0x00, 0x00, 0x00, 0x00, 0x00, 0x00, 0x00, 0x00, 0x00, 0x00, 0x00,
  0xf8, 0x1f, 0x00, 0x00, 0x00, 0x00, 0xff, 0xff, 0x00, 0x00, 0x00, 0xc0, 0x9f, 0xf9, 0x03, 0x00,
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  0x00, 0x00, 0x00, 0x00, 0x00, 0x00, 0x00, 0x00, 0x00, 0x00, 0x00, 0x00, 0x00, 0x00, 0x00, 0x00
};

// Array of all bitmaps for convenience. (Total bytes used to store images in PROGMEM = 304)
const int epd_bitmap_allArray_LEN = 1;

const unsigned char* epd_bitmap_allArray[3] = {
  epd_bitmap_emo_smile,
  epd_bitmap_emo_smile_brush,
  epd_bitmap_spiderman
};

int modeTampilan;
int maksMode = 2;

void setup() {
  pinMode(START_BTN, INPUT_PULLUP);
  pinMode(STOP_BTN, INPUT_PULLUP);

  SPI.begin();
  u8g2.begin();

  tampilanText("", "Mulai Test ESP32");
}

void loop() {
  if (digitalRead(START_BTN) == 0) {
    // Menamabah nilai pada modeTampilan sebanyak 1 (modeTampilan + 1)
    modeTampilan++;

    // TEKAN TAHAN - Menahan agar tombol tidak mengubah mode ketika ditekan terus
    while (digitalRead(START_BTN) == 0) {
    }
    // TEKAN TAHAN - Selesai
  }

  if (digitalRead(STOP_BTN) == 0) {
    // Mengurangi nilai pada modeTampilan sebanyak 1 (modeTampilan - 1)
    modeTampilan--;

    // TEKAN TAHAN - Menahan agar tombol tidak mengubah mode ketika ditekan terus
    while (digitalRead(STOP_BTN) == 0) {
    }
    // TEKAN TAHAN - Selesai
  }

  // Mulai Mengoreksi nilai dari modeTampilan supaya tetap di dalam nilai mode yang tersedia
  // ======================================================================================
  // Aktifkan untuk mengantisipasi jika modeTampilan menjadi lebih dari `2` supaya di jadikan maksimal `2`
  // dan jika modeTampilan menjadi kurang dari NOL supaya di jadikan miniman NOL
  // if (modeTampilan > maksMode) {
  //   modeTampilan = maksMode;
  // }

  // if (modeTampilan < 0) {
  //   modeTampilan = 0;
  // }

  // Aktifkan untuk mengantisipasi jika modeTampilan menjadi lebih dari `2` supaya dikembalikan ke `0`
  // dan jika modeTampilan menjadi kurang dari `0` supaya dikembalikan ke `2`
  if (modeTampilan > maksMode) {
    modeTampilan = 0;
  }

  if (modeTampilan < 0) {
    modeTampilan = maksMode;
  }
  // Selesai Mengoreksi modeTampilan

  // Memanggil Fungsi `void tampilan` dengan mengirim data `modeTampilan` saat ini
  tampilan(modeTampilan);
}

// Fungsi untuk menampilkan Tulisan konten dan Judul
void tampilanText(String konten, String judul) {
  u8g2.clearBuffer();
  u8g2.setFont(u8g2_font_luBS08_tf);
  // menampilakan isi dari variabel `konten` yang diterima
  u8g2.drawStr(32, 48, konten.c_str());
  // menampilakan isi dari variabel `judul` yang diterima
  u8g2.drawStr(0, 10, judul.c_str());
  u8g2.sendBuffer();
}
// Fungsi Selesai

// Fingsi Untuk Menampilkan ICON / Gambar berdasarkan urutan Gambar di "epd_bitmap_allArray"
void icon(int _nomorIcon, String _judul) {
  u8g2.clearBuffer();
  u8g2.drawXBM(40, 16, 48, 48, epd_bitmap_allArray[_nomorIcon]);
  u8g2.drawStr(0, 10, _judul.c_str());
  u8g2.sendBuffer();
}
// Fungsi Selesai

// Fungsi untuk memilih tampilan berdasarkan modeTampilan
void tampilan(int _modeTampilan) {
  if (_modeTampilan == 1) {
    // memanggil `void icon` dan mengirim data `1`
    icon(1, "Venom");
  } else if (_modeTampilan == 2) {
    // memanggil `void icon` dan mengirim data `2`
    icon(2, "I'm Spiderman");
  } else {
    // memanggil `void icon` dan mengirim data `0`
    icon(0, "Peter Parker");
  }
}
// Fungsi Selesai